#include "oled.h"
#include "stm32f4xx_hal.h"
#include <string.h>
#include <stdio.h>

extern I2C_HandleTypeDef hi2c1;  // ??main.c?CubeMX???I2C??

#define OLED_ADDR  0x78   // OLED?I2C??
#define OLED_CMD   0x00   // ????
#define OLED_DATA  0x40   // ????

// ============ 6x8???? ============
// ??ASCII?32?126?95??????
// ????6?8?,?6???
static const uint8_t Font6x8[][6] = {
    {0x00,0x00,0x00,0x00,0x00,0x00}, // space 32
    {0x00,0x00,0x5F,0x00,0x00,0x00}, // ! 33
    {0x00,0x07,0x00,0x07,0x00,0x00}, // " 34
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    {0x08,0x04,0x08,0x10,0x08,0x00}, // ~ 126
};

// ?OLED???????
static void OLED_WriteCmd(uint8_t cmd) {
    uint8_t buf[2];
    buf[0] = OLED_CMD;
    buf[1] = cmd;
    HAL_I2C_Master_Transmit(&hi2c1, OLED_ADDR, buf, 2, 100);
}

// ?OLED???????
static void OLED_WriteData(uint8_t data) {
    uint8_t buf[2];
    buf[0] = OLED_DATA;
    buf[1] = data;
    HAL_I2C_Master_Transmit(&hi2c1, OLED_ADDR, buf, 2, 100);
}

// OLED???
void OLED_Init(void) {
    HAL_Delay(100);
    OLED_WriteCmd(0xAE);
    OLED_WriteCmd(0x20); OLED_WriteCmd(0x02);
    OLED_WriteCmd(0xB0);
    OLED_WriteCmd(0xC8);
    OLED_WriteCmd(0x00); OLED_WriteCmd(0x10);
    OLED_WriteCmd(0x40);
    OLED_WriteCmd(0x81); OLED_WriteCmd(0xFF);
    OLED_WriteCmd(0xA1);
    OLED_WriteCmd(0xA6);
    OLED_WriteCmd(0xA8); OLED_WriteCmd(0x3F);
    OLED_WriteCmd(0xD3); OLED_WriteCmd(0x00);
    OLED_WriteCmd(0xD5); OLED_WriteCmd(0x80);
    OLED_WriteCmd(0xD9); OLED_WriteCmd(0xF1);
    OLED_WriteCmd(0xDA); OLED_WriteCmd(0x12);
    OLED_WriteCmd(0xDB); OLED_WriteCmd(0x40);
    OLED_WriteCmd(0x8D); OLED_WriteCmd(0x14);
    OLED_WriteCmd(0xAF);
    OLED_Clear();
}

// ??
void OLED_Clear(void) {
    uint8_t i, j;
    for (i = 0; i < 8; i++) {
        OLED_WriteCmd(0xB0 + i);
        OLED_WriteCmd(0x00);
        OLED_WriteCmd(0x10);
        for (j = 0; j < 128; j++) {
            OLED_WriteData(0x00);
        }
    }
}

// ?????????
void OLED_ShowString(uint8_t line, char *str) {
    uint8_t i, col;
    if (line > 7) line = 7;
    OLED_WriteCmd(0xB0 + line);
    OLED_WriteCmd(0x00);
    OLED_WriteCmd(0x10);
    for (i = 0; str[i] != '\0' && i < 16; i++) {
        uint8_t c = str[i] - 32;
        if (c > 94) c = 0;
        for (col = 0; col < 6; col++) {
            OLED_WriteData(Font6x8[c][col]);
        }
        OLED_WriteData(0x00);
    }
}

// ?????????
void OLED_ShowFloat(uint8_t line, float num, uint8_t decimals) {
    char buf[20];
    if (decimals == 2) {
        sprintf(buf, "%.2f", num);
    } else if (decimals == 3) {
        sprintf(buf, "%.3f", num);
    } else if (decimals == 4) {
        sprintf(buf, "%.4f", num);
    } else {
        sprintf(buf, "%.1f", num);
    }
    OLED_ShowString(line, buf);
}